## conf/layer.conf
```bitbake
# We have a conf and classes directory, add to BBPATH
BBPATH .= ":${LAYERDIR}"

# We have recipes-* directories, add to BBFILES
BBFILES += "${LAYERDIR}/recipes-*/*.bb \
            ${LAYERDIR}/recipes-*/*.bbappend \
            ${LAYERDIR}/recipes-*/*/*.bb \
            ${LAYERDIR}/recipes-*/*/*.bbappend"


BBFILES_DYNAMIC += " \
    swupdate:${LAYERDIR}/dynamic-layers/swupdate/*/*.bb \
    swupdate:${LAYERDIR}/dynamic-layers/swupdate/*/*.bbappend \
"
BBFILE_COLLECTIONS += "meta-solidrun-hailo"
BBFILE_PATTERN_meta-solidrun-hailo = "^${LAYERDIR}/"
BBFILE_PRIORITY_meta-solidrun-hailo = "8"

LAYERDEPENDS_meta-solidrun-hailo = " \
    meta-hailo-bsp \
"

LAYERSERIES_COMPAT_meta-solidrun-hailo = "kirkstone"
```
